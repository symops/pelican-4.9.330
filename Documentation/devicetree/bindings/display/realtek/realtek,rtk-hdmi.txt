## drivers/soc/realtek/common/Kconfig
```kconfig
config RTK_CHIP_INFO
	tristate "RTK SOC Chip information"
	default y
	select SOC_BUS
	---help---
	  The Realtek chips information.

config RTK_MEM_REMAP
	bool "Realtek memory remap"
	default y
	---help---
	  Enable helper functions for static ioremap. If unsure, say N.

config RTK_RBUS_BARRIER
	bool "Realtek rbus barrier"
	depends on RTK_MEM_REMAP
	default y
	---help---
	  Enable helper functions for R-bus barrier. If unsure, say N.

config RTK_SB2_MEM_TRASH_MONITOR
	bool "Realtek memory trash monitor"
	default y
	---help---
	  Enable helper functions for memory trash detection. If unsure, say N.

config RTK_USB_CTRL_MANAGER
	tristate "RTK Multiple USB Host/Device Controller Manager"
	default y if USB_OHCI_RTK || USB_EHCI_RTK || USB_DWC3_RTK
	---help---
	  The Realtek chips are Multiple host/peripheral USB controllers.
	  Enable the driver to control clock, reset and usb power gpio.

config RTK_MCP
	bool "Realtek MCP driver"
	default n
	---help---
	  Realtek MCP driver

config RTK_FAN
	bool "RTK Fan driver"
	default n
	---help---
	  Realtek Fan driver

config RTK_TRANSCODE
	bool "Support RTK Transcode"
	default n
	---help---
	  Adjust ION heap for transcode

source "drivers/soc/realtek/common/rpc/Kconfig"
source "drivers/soc/realtek/common/dvfs/Kconfig"
source "drivers/soc/realtek/common/rtk_pd/Kconfig"
source "drivers/soc/realtek/common/rtk_se/Kconfig"
```

## drivers/soc/realtek/common/dvfs/Kconfig
```kconfig
config RTK_CPU_CACHE_SUPPLY_COORDINATOR
	bool "Realtek CPU cache supply coordinator"
	depends on REGULATOR_G2227
	depends on ARCH_RTD129x
	default y

config RTK_CPU_HIGH_LOAD_BOOSTER
	bool "Realtek CPU high-load booster"
	default n

config RTK_CPU_VOLT_SEL
	bool "Add OPP prop extn to CPU device"
	default y
```

## drivers/soc/realtek/common/rtk_pd/Kconfig
```kconfig
menu "Realtek Power Domain"

config PD_REALTEK
	bool "Realtek Power Domain Support"
	depends on PM
	depends on RTK_PLATFORM
	select PM_GENERIC_DOMAINS
	default y

config PD_RTD1295
	bool "Realtek RTD1295 Power Domain Driver"
	depends on PD_REALTEK
	default y if ARCH_RTD129x
	help
	  Realtek RTD1295 Power Domain Driver Support

endmenu
```

## drivers/soc/realtek/common/rtk_se/Kconfig
```kconfig
config RTK_SE
	bool "Realtek Streaming Engine DMA driver"
	default n
	help
	  Enable Realtek SE-DMA driver. If unsure, say N.
```

## drivers/soc/realtek/rtd129x/Kconfig
```kconfig
menu "RTD129x Device Drivers"

config RTK_SW_LOCK_API
	bool "Realtek SW LOCK API"
	default y
	---help---
	  Realtek SW LOCK API driver

source "drivers/soc/realtek/rtd129x/rtk_ve/Kconfig"

endmenu #RTD129x Device Drivers
```

## drivers/thermal/realtek/Kconfig
```kconfig
config RTK_THERMAL
	bool "Realtek thermal management"
	depends on OF && THERMAL_OF
	help
	  Enable thermal management with a generic thermal
	  sensor driver on Realtek SoCs.

	  If you want this support, you should say Y here.

config RTK_THERMAL_EOH
	bool "Realtek thermal sensor EOH"
	depends on RTK_THERMAL

config RTK_THERMAL_CPU_CORE_COOLING
	bool "Realtek CPU core cooling device"
	help
	  This enable Realtek CPU core cooling device drvier

	  If not sure, say N
```
