## Documentation/devicetree/bindings/display/realtek/realtek,rtk-hdmi.txt
```
Example:

display-subsystem {
	compatible = "realtek,display-subsystem";
};

vedio_out: vo@98000000 {
	compatible = "realtek,crtc";
	reg = <0x0 0x98000000 0x0 0x100>;
	vo: port {
		#address-cells = <1>;
		#size-cells = <0>;
		vo_hdmi: endpoint@0 {
			reg = <0>;
			remote-endpoint = <&hdmi_in_vo>;
		};
	};
};

hdmi: hdmi@9800D000 {
    compatible = "realtek,rtk-hdmi";
	reg = <0x0 0x9800d000 0x0 0x560>;
	gpio-hpd-detect = <&rtk_iso_gpio 7 0 0>;
	hdmi_in: port {
		#address-cells = <1>;
		#size-cells = <0>;
		hdmi_in_vo: endpoint@0 {
			reg = <0>;
			remote-endpoint = <&vo_hdmi>;
		};
	};
}
```

## Documentation/devicetree/bindings/mfd/g22xx.txt
```
GMT-G2227/G2237 PMIC DT-bindings
================================

G22XX series PMIC contains the following sub devices:
	g2227-regulator for G2227,
	g2237-regulator for G2237.

Sub nodes:

regulators
----------

Required properties:

* compatible: shall contains one of the following
	"gmt,g2227-regulator",
	"gmt,g2237-regulator".

	See also Documentation/devicetree/bindings/regulator/regulator.txt.

Example:

	&i2c_0 {
		status = "okay";

		g2237: g2237@12 {
			compatible = "gmt,g2237";
			reg = <0x12>;
			status = "okay";

			powerkey: powerkey {
				compatible = "gmt,g22xx-powerkey";
				lp-handler = "sw";
				it-handler = "sw";
				time-sel = <0 0 3>;
				status = "okay";
			};
			regulators: regulators {
				compatible = "gmt,g2237-regulator";
				status = "okay";
			};
		};
	};
```

## Documentation/devicetree/bindings/soc/realtek/dcsys_pmu.txt
```
Realtek DC-SYS PMU dt-bindings
==============================

Required properties:
- compatible:
        - "realtek,rtk-16xx-dc-pmu" for rtd16xx family
        - "realtek,rtk-13xx-dc-pmu" for rtd13xx family
- reg: Address range of DC-SYS PMU

Example:

	rtk-dc-pmu@98008000 {
                compatible = "realtek,rtk-16xx-dc-pmu";
                reg = <0x0 0x98008000 0x0 0x0900>;
	};
```

## Documentation/devicetree/bindings/soc/realtek/ddrc_pmu.txt
```
Realtek customized Synopsis DDR memory controller PMU dt-bindings
=================================================================

Required properties:
- compatible:
        "realtek,rtk-13xx-ddrc-pmu"
- reg: Address range of DDR controller PMU

Example:

	rtk-ddrc-pmu@98094000 {
                compatible = "realtek,rtk-ddrc-pmu";
                reg = <0x0 0x98094000 0x0 0x040>;
	};
```

## Documentation/devicetree/bindings/soc/realtek/dmc_pmu.txt
```
Realtek DDR memory controller PMU dt-bindings
=============================================

Required properties:
- compatible:
        "realtek,rtd-dmc-pmu"
- reg: Address range of DDR controller PMU

Example:

	rtk-dmc-pmu@9800EB00 {
                compatible = "realtek,rtk-dmc-pmu";
                reg = <0x0 0x9800EB00 0x0 0x040>;
	};
```

## Documentation/devicetree/bindings/soc/realtek/power-domain.txt
```
Realtek Power Domain DT-bindings
================================

required propertise:

- compatible : shall contain the one of followings :
        "realtek,rtd1295-power",
        "realtek,rtd1395-power",
        "realtek,rtd1619-power",
        "realtek,rtd1319-power",
        "realtek,rtd1619b-power".

- #power-domain-cells : shall contain unsigned int 1
```

## Documentation/devicetree/bindings/soc/realtek/power.txt
```
Realtek Power Control DT-bindings
=================================

Power Controller
----------------

* Required properities:

- compatible : shall contain the followings :

- reg : shall contain the base address of io memory.

* Optional properities:

- #power-domain-cells : shall contain unsigned int 1, required if the
			power-controller is a power domain provider.

- #powerctrl-cells : shall contain unsigned int 1, required if
		     power-controller is a power control provider.
```

## Documentation/devicetree/bindings/soc/realtek/rbus_pmu.txt
```
Realtek Register bus PMU dt-bindings
=============================================

Required properties:
- compatible:
        - "realtek,rtk-16xx-rbus-pmu" for rtd16xx family
        - "realtek,rtk-13xx-rbus-pmu" for rtd13xx family
- reg: Address range of register bus PMU

Example:

	rtk-rbus-pmu@9801A400 {
                compatible = "realtek,rtk-13xx-rbus-pmu";
                reg = <0x0 0x9801A400 0x0 0x060>;
	};
```

## Documentation/devicetree/bindings/soc/realtek/refclk.txt
```
refclk dt-bindings
==================

Provider
--------

Required property:

compatible: should be "realtek,refclk".

reg: shold contain the io space of refclk


Example:

	refclk: refclk@12345678 {
		compatible = "realtek,refclk";
		...
	};

Consumer
--------

Required property:

realtek,refclk: a phandle to refclk

Example:
	consumer {
		realtek,refclk = <&refclk>;
	};
```

## Documentation/devicetree/bindings/soc/realtek/rtc_reload.txt
```
Realtek RTC Reload DT-binding
=============================

* required properties:

- compatible: shall contain "realtek,rtc-reload".

- reg: shall contain 1 register address.

Example:

	rtc-reload@9800765c {
		compatible = "realtek,rtc-reload";
		reg = <0x0 0x9800765c 0x0 0x4>;
		status = "okay";
	};
```

## Documentation/devicetree/bindings/soc/realtek/sb2.txt
```
Realtek System Bridge 2 Driver DT-bindings
==========================================

Core Driver
-----------

Required properties:

- compatible: should be one of the following,
	"realtek,rtd1295-sysbrg2",
	"realtek,rtd1395-sysbrg2",
	"realtek,rtd1619-sysbrg2",
	"realtek,rtd1319-sysbrg2".


Debug Driver
------------

Required properties:

- compatible: should be "realtek,sysbrg2-dbg"

- reg: should contain the io register sapce

- interrupts: interrupt

Optional properties:

- nvmem-cells: nvmem for checking secure chip

- nvmem-cell-names: nvmem name above, should be 'secure_en';


Invalid Access Driver
---------------------

Required properties:

- compatible: should be "realtek,sysbrg2-inv"

- reg: should contain the io register sapce

- interrupts: interrupt

Optional properties:

- nvmem-cells: nvmem for checking secure chip

- nvmem-cell-names: nvmem name above, should be 'secure_en';
```

## Documentation/devicetree/bindings/soc/realtek/sc_wrap.txt
```
Realtek SCPU Wrapper DT-binding
===============================

Debug Driver
------------

Required properties:

- compatible: should contain "realtek,scpu-wrapper-dbg"

- reg: should be to io register of dbg function

- interrupts: the interrupt

Optional properties:

- nvmem-cells and nvmem-cell-names: nvmem for checking chip type


FSS Driver
----------

Required properties:

- compatible: should contain "realtek,scpu-wrapper-fss"

- reg: should be to io register of fss function
```

## Documentation/devicetree/bindings/soc/realtek/tp.txt
```
Realtek TP DT-binding
========================

* required properties:

- compatible: shall contain "realtek,tp".

- reg: shall contain at least 1 register address.

- clockL shall contain num to register num

  See also Documentation/devicetree/bindings/clock/clock-bindings.txt


Example:

tp@98014000 {
	compatible = "realtek,tp";
	reg = <0x0 0x98014000 0x0 0x1000>,
	      <0x0 0x98039000 0x0 0x1000>;
	clocks = <&clk_en_2 CLK_EN_TP>, <&clk_en_2 CLK_EN_TPB>;
	status = "okay";
};
```
